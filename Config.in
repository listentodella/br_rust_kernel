## Config.in
```kconfig
menu "My External Kernel Module"
source "$BR2_EXTERNAL_RUST_PATH/package/kernel_module/c/mykernelmodule/Config.in"
source "$BR2_EXTERNAL_RUST_PATH/package/kernel_module/c/mm/Config.in"
source "$BR2_EXTERNAL_RUST_PATH/package/kernel_module/rs/vdev/Config.in"
source "$BR2_EXTERNAL_RUST_PATH/package/kernel_module/rs/mm/Config.in"
endmenu
```

## configs/qemu_aarch64_virt_rust_defconfig
```kconfig
BR2_aarch64=y
BR2_TOOLCHAIN_EXTERNAL=y
BR2_DL_DIR="~/brdl"
BR2_CCACHE=y
BR2_GLOBAL_PATCH_DIR="board/qemu/patches"
BR2_SYSTEM_DHCP="eth0"
BR2_ROOTFS_POST_IMAGE_SCRIPT="board/qemu/post-image.sh"
BR2_ROOTFS_POST_SCRIPT_ARGS="$(BR2_DEFCONFIG)"
BR2_LINUX_KERNEL=y
BR2_LINUX_KERNEL_USE_CUSTOM_CONFIG=y
#BR2_LINUX_KERNEL_CUSTOM_CONFIG_FILE="board/qemu/aarch64-virt/linux.config"
BR2_LINUX_KERNEL_CUSTOM_CONFIG_FILE="$(BR2_EXTERNAL_RUST_PATH)/linux/kernel_rust_defconfig"
BR2_LINUX_KERNEL_CONFIG_FRAGMENT_FILES="$(BR2_EXTERNAL_RUST_PATH)/linux/linux-fragment.cfg"
BR2_LINUX_KERNEL_NEEDS_HOST_OPENSSL=y
BR2_TARGET_ROOTFS_EXT2=y
BR2_TARGET_ROOTFS_EXT2_4=y
# BR2_TARGET_ROOTFS_TAR is not set
BR2_PACKAGE_HOST_QEMU=y
BR2_PACKAGE_HOST_QEMU_SYSTEM_MODE=y
```

## package/kernel_module/c/mm/Config.in
```kconfig
menu "MM C Modules"

config BR2_PACKAGE_MM_C
    bool "kernel mem learing in C"
    depends on BR2_LINUX_KERNEL
    help
      Memory Learing in C

if BR2_PACKAGE_MM_C
    source "$BR2_EXTERNAL_RUST_PATH/package/kernel_module/c/mm/get_mem_info/Config.in"
endif


endmenu
```

## package/kernel_module/c/mm/get_mem_info/Config.in
```kconfig
config BR2_PACKAGE_GET_MEM_INFO
    bool "get system memory info in C"
    depends on BR2_LINUX_KERNEL
    help
      Memory Learing in C
```

## package/kernel_module/c/mykernelmodule/Config.in
```kconfig
config BR2_PACKAGE_MYKERNELMODULE
    bool "my kernel module"
    depends on BR2_LINUX_KERNEL
    help
      A custom kernel module example.
```

## package/kernel_module/rs/mm/Config.in
```kconfig
menu "MM(Memory Management) Modules"

config BR2_PACKAGE_MM
    bool "kernel mem learing in RUST"
    depends on BR2_LINUX_KERNEL
    help
      Memory Learing in RUST

if BR2_PACKAGE_MM
    source "$BR2_EXTERNAL_RUST_PATH/package/kernel_module/rs/mm/get_system_mem_info/Config.in"
endif


endmenu
```

## package/kernel_module/rs/mm/get_system_mem_info/Config.in
```kconfig
config BR2_PACKAGE_GET_SYSTEM_MEM_INFO
    bool "get system memory info in RUST"
    depends on BR2_LINUX_KERNEL
    help
      Memory Learing in RUST
```

## package/kernel_module/rs/mm/rs_alloc_mem/Config.in
```kconfig
config BR2_PACKAGE_RS_ALLOC_MEM
    bool "alloc mem in RUST"
    depends on BR2_LINUX_KERNEL
    help
      Memory Learing in RUST
```

## package/kernel_module/rs/mm/rs_get_mem_info/Config.in
```kconfig
config BR2_PACKAGE_RS_GET_MEM_INFO
    bool "get system memory info in RUST"
    depends on BR2_LINUX_KERNEL
    help
      Memory Learing in RUST
```

## package/kernel_module/rs/vdev/Config.in
```kconfig
config BR2_PACKAGE_VDEV
    bool "my kernel rust virtual dev"
    depends on BR2_LINUX_KERNEL
    help
      A custom kernel module example in rust
```
